## kernel/Kconfig
```kconfig
mainmenu "Onyx $(ONYX_ARCH) kernel configuration"

source "arch/Kconfig"
source "arch/$(ONYX_ARCH)/Kconfig"

source "drivers/Kconfig"
source "kernel/Kconfig"
source "lib/Kconfig"
```

## kernel/arch/Kconfig
```kconfig
config CLONE_BACKWARDS
	bool
	help
	  Architecture has tls passed as the 4th argument of clone(2),
	  not the 5th one.

config CLONE_BACKWARDS2
	bool
	help
	  Architecture has the first two arguments of clone(2) swapped.

config CLONE_BACKWARDS3
	bool
	help
	  Architecture has tls passed as the 3rd argument of clone(2),
	  not the 5th one.
```

## kernel/arch/x86_64/Kconfig
```kconfig
config X86
	def_bool y

menu "Architecture Options"

config X86_PLATFORM
	string
	prompt "Platform for which the kernel is being configured"
	default "pc"
	select PCI
	select AHCI
	select ATA
	select EFI
	help
	 Platform for which the kernel is being configured.
	 This option controls what drivers get selected by default.
	 The only valid choice is 'pc'.

config RELOCATABLE_PHYS
	bool "Physically relocatable kernel support"
	default y
	help
		Controls if the kernel is physically relocatable. Decreases the
		likelyhood of certain attacks while improving chances it boots on weird
		physical memory maps. Has very little to no cost. 

		If in doubt, say Y.

config X86_MITIGATE_SLS
	bool "Straight Line Speculation mitigation"
	default y
	help
		Mitigate against x86 SLS attacks, at the cost of performance.

		If in doubt, say Y.

config X86_RETPOLINE
	bool "Retpoline mitigations (for spectre v2)"
	default y
	help
		Mitigate against spectre v2 by employing retpoline.
		Has a very palpable cost on indirect branches.

		If in doubt, say Y.

config X86_RETHUNK
	bool "Rethunk mitigations (for Retbleed)"
	default y
	help
		(Try to) mitigate retbleed by employing a return think.
		Has a very palpable performance cost.

		If in doubt, say Y.

config VERBOSE_SEGV
	bool "Dump verbose segfault logs in dmesg"
	help
		Dump whatever info we can get (stack addresses, etc) and map them into
		file + offset (for later symbolization).
endmenu
```

## kernel/drivers/Kconfig
```kconfig
menu "Drivers"

source "drivers/acpi/Kconfig"
source "drivers/ps2/Kconfig"
source "drivers/rtc/Kconfig"
source "drivers/serial/Kconfig"
source "drivers/virtio/Kconfig"
source "drivers/net/Kconfig"
source "drivers/nvme/Kconfig"
source "drivers/firmware/Kconfig"
source "drivers/ata/Kconfig"
source "drivers/ahci/Kconfig"
source "drivers/pci/Kconfig"
source "drivers/bga/Kconfig"
source "drivers/irqchip/Kconfig"

endmenu
```

## kernel/drivers/acpi/Kconfig
```kconfig
config ACPI
    def_bool y
    prompt "ACPI support"
    help
     Enable support for the Advanced Configuration and Power Interface (ACPI). This
     option will enlargen your kernel by a significant amount. Strongly recommended to choose Y,
     particularly for modern x86/arm64/riscv64 systems.
```

## kernel/drivers/ahci/Kconfig
```kconfig
config AHCI
    tristate "Advanced Host Controller Interface support"
    depends on PCI
    help
        Advanced Host Controller Interface storage support.
        Pick this if you're running a remotely modern x86 PC.
```

## kernel/drivers/ata/Kconfig
```kconfig
config ATA
    tristate "IDE ATA support"
    depends on PCI
    help
        IDE ATA support. Pick this if you're running on a virtual machine, or an older x86 PC machine.
```

## kernel/drivers/bga/Kconfig
```kconfig
config BGA
    tristate "Bochs VGA support"
    depends on PCI
    help
        Bochs VGA support.
        If planning to run on virtual machines, say Y/M.
```

## kernel/drivers/firmware/efi/Kconfig
```kconfig
config EFI
    bool "EFI firmware support"
    help
        EFI firmware (runtime) support. Pick this if you have a remotely modern x86 PC,
        an arm64 server or a riscv64 board with EFI.
```

## kernel/drivers/irqchip/Kconfig
```kconfig
menu "Interrupt controllers"

config IRQCHIP_GIC
    bool "ARM Generic Interrupt Controller support"
    depends on ARM64
    default y
    help
        The ARM Generic Interrupt Controller (GIC) is a very common interrupt
        controller for standard ARM systems. If you have such a system, say Y.

endmenu
```

## kernel/drivers/pci/Kconfig
```kconfig
menuconfig PCI
    bool "Peripheral Component Interconnect bus support"
    help
        PCI bus support. When in doubt, say Y. 
```

## kernel/drivers/ps2/Kconfig
```kconfig
config PS2
    bool "PS/2 controller (& keyboard/mouse) support"
    default y if X86_PLATFORM = "pc"
    depends on X86_PLATFORM = "pc"
    help
        8042 PS/2 controller support. This driver provides keyboard/mouse for most x86 PCs. 
```

## kernel/drivers/rtc/Kconfig
```kconfig
menu "Real-time clock support"

config RTC_PC
    def_bool y if X86_PLATFORM = "pc"
    depends on X86_PLATFORM = "pc"
    prompt "PC RTC Support"
    help
        RTC support for commodity x86 PCs.

config RTC_GOLDFISH
    bool
    prompt "Goldfish RTC support"
    help
        RTC support for Goldfish, which is common hardware for virtual machines.

config RTC_PL031
    bool
    prompt "PL031 RTC support"
    depends on DEVICE_TREE
    help
        PL031 RTC support, which is commonly found on smaller boards.
endmenu
```

## kernel/drivers/serial/Kconfig
```kconfig
menu "Serial UART support"

menuconfig SERIAL_UART8250
    bool "UART8250 serial support"
    default y if X86_PLATFORM = "pc"
    help
        UART8250 support. Provides serial for lots of commodity x86 PCs.
if SERIAL_UART8250
    config SERIAL_UART8250_ACPI
        bool "UART 8250 ACPI support"
        default y if ACPI
        depends on ACPI
        help
            Support for binding to UART 8250 hardware using ACPI.
            When in doubt, say Y.
    config SERIAL_UART8250_DEVTREE
        bool "UART 8250 device tree support"
        default y if DEVICE_TREE
        depends on DEVICE_TREE
        help
            Support for binding and discovering UART8250 hardware using the device tree.
            When in doubt, say Y.

endif

config SERIAL_PL011
    bool "PL011 serial support"
    depends on DEVICE_TREE
    help
        PL011 support. Provides serial for many ARM devices and smaller boards.
        When in doubt, say Y.

endmenu
```

## kernel/drivers/virtio/Kconfig
```kconfig
menuconfig VIRTIO
    bool "Virtio device support"
    depends on PCI
    help
        Virtio device support. For now, only virtio PCI devices are supported.
        If looking to run on virtual machines, say Y/M.

if VIRTIO
    config VIRTIO_BLK
        bool "virtio-blk device support"
        help
            Virtio block device support. If looking to run on virtual machines, say Y/M.
    
    config VIRTIO_NET
        bool "virtio-net device support"
        depends on NET
        help
            virtio-net NIC device support. If looking to run on virtual machines, say Y/M.
endif
```

## kernel/kernel/Kconfig
```kconfig
source "kernel/net/Kconfig"
source "kernel/fs/Kconfig"
source "kernel/mm/Kconfig"

menu "Security options"

config KASLR
    bool "Kernel Address Space Layout Randomization"
    default y
    help
        Enable Kernel Address Space Layout Randomization. Results in a likely
        slight performance hit, but is important in the defence of the system
        against attacks.

        If in doubt, say Y.

config ASLR
    bool "Address Space Layout Randomization (userspace)"
    default y
    help
        Enable Address Space Layout Randomization. Results in a likely
        slight performance hit, but is important in the defence of the system
        against attacks.

        If in doubt, say Y.


endmenu

menu "Debugging options"

config DEBUG_MAPLE_TREE
    bool "Maple tree debugging"
    help
        Enable Maple Tree Debugging checks.

        If in doubt, say N.

config DEBUG_ADDRESS_SPACE_ACCT
    bool "Address space accounting checks"
    help
        Enable address space accounting checks around various places.
        Has a very real cost.

        If in doubt, say N.

config DEBUG_MM_MMAP
    bool "mmap tree validation checks"
    help
        Enable mmap tree validation checks after most mmap tree operations.
        Has a very real cost.

        If in doubt, say N.

config DCHECK
    bool "Enable debug CHECKs (DCHECKs)"
    help
        Enable debug assertions. Code should not be behaviorally impacted.

        If in doubt, say N.

config UBSAN
    bool "Undefined Behavior Sanitizer (UBSAN)"
    help
        Enable UBSAN, which detects undefined behavior. It's very useful
        when developing, but has a real performance cost.

        If in doubt, say N.

config KASAN
    bool "Kernel Address Space Sanitizer (KASAN)"
    help
        Enable KASAN, which finds all sorts of memory errors. It's very useful
        when developing, but has a _very_ real performance and memory cost.

        If in doubt, say N.

if KASAN
    config KASAN_QUARANTINE_PCPU_SIZE
        hex "KASAN quarantine percpu size"
        default 0x100000
        help
            Controls the KASAN quarantine percpu size. Has an impact on performance *and* memory usage.

    config KASAN_QUARANTINE_SIZE
        hex "KASAN quarantine size"
        default 0x10000000
        help
            Controls the KASAN quarantine size. Has an impact on memory usage. If too
            high (compared to the memory size), you might experience system instability.
endif

config TRACE_IRQFLAGS
    bool

config PROVE_LOCKING
	bool "Lock debugging: prove locking correctness"
	select LOCKDEP
	select DEBUG_SPINLOCK
	select DEBUG_MUTEXES if !PREEMPT_RT
	select DEBUG_RT_MUTEXES if RT_MUTEXES
	select DEBUG_RWSEMS if !PREEMPT_RT
	select DEBUG_WW_MUTEX_SLOWPATH
	select DEBUG_LOCK_ALLOC
	select PREEMPT_COUNT if !ARCH_NO_PREEMPT
	select TRACE_IRQFLAGS
	default n
	help
	 This feature enables the kernel to prove that all locking
	 that occurs in the kernel runtime is mathematically
	 correct: that under no circumstance could an arbitrary (and
	 not yet triggered) combination of observed locking
	 sequences (on an arbitrary number of CPUs, running an
	 arbitrary number of tasks and interrupt contexts) cause a
	 deadlock.

	 In short, this feature enables the kernel to report locking
	 related deadlocks before they actually occur.

	 The proof does not depend on how hard and complex a
	 deadlock scenario would be to trigger: how many
	 participant CPUs, tasks and irq-contexts would be needed
	 for it to trigger. The proof also does not depend on
	 timing: if a race and a resulting deadlock is possible
	 theoretically (no matter how unlikely the race scenario
	 is), it will be proven so and will immediately be
	 reported by the kernel (once the event is observed that
	 makes the deadlock theoretically possible).

	 If a deadlock is impossible (i.e. the locking rules, as
	 observed by the kernel, are mathematically correct), the
	 kernel reports nothing.

	 NOTE: this feature can also be enabled for rwlocks, mutexes
	 and rwsems - in which case all dependencies between these
	 different locking variants are observed and mapped too, and
	 the proof of observed correctness is also maintained for an
	 arbitrary combination of these separate locking variants.

	 For more details, see Documentation/locking/lockdep-design.rst.

config LOCKDEP
	bool
	select STACKTRACE
	select KALLSYMS
	select KALLSYMS_ALL

config LOCKDEP_SMALL
	bool

config LOCKDEP_BITS
	int "Size for MAX_LOCKDEP_ENTRIES (as Nth power of 2)"
	depends on LOCKDEP && !LOCKDEP_SMALL
	range 10 24
	default 15
	help
	  Try increasing this value if you hit "BUG: MAX_LOCKDEP_ENTRIES too low!" message.

config LOCKDEP_CHAINS_BITS
	int "Size for MAX_LOCKDEP_CHAINS (as Nth power of 2)"
	depends on LOCKDEP && !LOCKDEP_SMALL
	range 10 21
	default 16
	help
	  Try increasing this value if you hit "BUG: MAX_LOCKDEP_CHAINS too low!" message.

config LOCKDEP_STACK_TRACE_BITS
	int "Size for MAX_STACK_TRACE_ENTRIES (as Nth power of 2)"
	depends on LOCKDEP && !LOCKDEP_SMALL
	range 10 26
	default 19
	help
	  Try increasing this value if you hit "BUG: MAX_STACK_TRACE_ENTRIES too low!" message.

config LOCKDEP_STACK_TRACE_HASH_BITS
	int "Size for STACK_TRACE_HASH_SIZE (as Nth power of 2)"
	depends on LOCKDEP && !LOCKDEP_SMALL
	range 10 26
	default 14
	help
	  Try increasing this value if you need large STACK_TRACE_HASH_SIZE.

config LOCKDEP_CIRCULAR_QUEUE_BITS
	int "Size for elements in circular_queue struct (as Nth power of 2)"
	depends on LOCKDEP
	range 10 26
	default 12
	help
	  Try increasing this value if you hit "lockdep bfs error:-1" warning due to __cq_enqueue() failure.

config KCSAN
    bool "Kernel Concurrency Sanitizer (KCSAN)"
    # KCSAN and KASAN are mutually excluded (by the compiler itself)
    depends on !KASAN
    help
        Enable KCSAN, which helps find concurrency issues, using a sampling method.
        Has a very real performance cost.

        If in doubt, say N.

config KCOV
    bool "Kernel coverage (kcov)"
    help
        Enable KCOV, which helps fuzzers find issues by giving them coverage data.
        Has a very real performance cost.

        If in doubt, say N.

config KUNIT
    bool "Kernel unit testing"
    help
        Enable kernel unit tests. Has a big footprint on kernel .text size.

        If in doubt, say N.

config PAGE_OWNER
    bool "Page owner tracking"
    help
        Enable page owner tracking. Helps debugging page lock/UAF issues.

        If in doubt, say N.

config SCHED_DUMP_THREADS_MAGIC
    bool "Numlock thread info dumping"
    help
        Enable thread info dumping for all threads in the system when the
        vterm recieves a numlock.

        If in doubt, say N.
endmenu

menu "Tracing options"

config KTRACE
    bool "Kernel tracing"
    default y
    help
        Enable ktrace, which is a bag of various different tracing facilities. Most importantly,
        required by trace(1). Should have near zero cost.

        If in doubt, say Y.

endmenu

menu "General kernel options"

config SMP_NR_CPUS
    int "Maximum number of CPUs"
    range 64 256
    default 64
    help
        Number of CPUs supported by the kernel (upper-bound).
        Substancially affects memory usage.

config LTO
    bool "Use Link-time optimization when building the kernel"
    help
        Use LTO when building the kernel. May result in worse debugging,
        tracing and possible breakage. Results in slower kernel builds.

        If in doubt, say N.
endmenu
```

## kernel/kernel/fs/Kconfig
```kconfig
menu "Filesystems"

config EXT2
    bool "ext2 filesystem support"
    default y
    help
        ext2 is the standard Onyx filesystem, and used/supported on other
        platforms such as Linux and the BSDs.

        If unsure, say Y.

config DEBUG_NAMEI_TRACE_OPS
    bool "Trace dentry namei operations"
    def_bool n
    help
        CONFIG_DEBUG_NAMEI_TRACE_OPS=y lets you trace filesystem namecache operations
        done in each specific dentry. Useful when debugging VFS refcounting problems.

        If you don't know what any of the above means, say N.
endmenu
```

## kernel/kernel/mm/Kconfig
```kconfig
menu "Memory Management options"

config PAGEALLOC_POISON
    bool "Page allocator poison-on-alloc"
    help
        Enable page poisoning on page allocation. This helps debugging
        uninitialized memory issues, and may improve security by wiping old
        page contents. There is however a performance penalty.

        If in doubt, say N.
endmenu
```

## kernel/kernel/net/Kconfig
```kconfig
config NET
    def_bool y
    prompt "Networking support"
    help
        Networking support, with a full TCP/IP stack (v4 + v6 + UDP), using Berkeley sockets.
        When in doubt, say Y.
```
